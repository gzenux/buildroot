## configs/nextvod_fd1080hd_defconfig
```kconfig
BR2_sh=y
BR2_SH_CPU_STX7105=y
BR2_SSP_STRONG=y
BR2_GLOBAL_PATCH_DIR="board/nextvod/fd1080hd/patches"
BR2_TOOLCHAIN_BUILDROOT_VENDOR="nextvod"
BR2_PACKAGE_HOST_LINUX_HEADERS_CUSTOM_REALLY_OLD=y
BR2_TOOLCHAIN_BUILDROOT_LOCALE=y
BR2_TOOLCHAIN_BUILDROOT_USE_SSP=y
# BR2_UCLIBC_INSTALL_UTILS is not set
BR2_BINUTILS_VERSION_2_27_X=y
BR2_TOOLCHAIN_BUILDROOT_CXX=y
BR2_GCC_ENABLE_LTO=y
BR2_TARGET_GENERIC_HOSTNAME="nextvod"
BR2_TARGET_GENERIC_ISSUE="Welcome to NextVOD"
BR2_ROOTFS_DEVICE_CREATION_DYNAMIC_MDEV=y
BR2_ROOTFS_DEVICE_TABLE="system/device_table_dev.txt"
# BR2_TARGET_ENABLE_ROOT_LOGIN is not set
BR2_ENABLE_LOCALE_WHITELIST="C en_US en_US.UTF-8"
BR2_SYSTEM_ENABLE_NLS=y
BR2_ROOTFS_POST_BUILD_SCRIPT="board/nextvod/fd1080hd/post-build.sh"
BR2_ROOTFS_POST_IMAGE_SCRIPT="board/nextvod/fd1080hd/post-image.sh"
BR2_LINUX_KERNEL=y
BR2_LINUX_KERNEL_CUSTOM_VERSION=y
BR2_LINUX_KERNEL_CUSTOM_VERSION_VALUE="2.6.32"
BR2_LINUX_KERNEL_DEFCONFIG="pdk7105"
BR2_PACKAGE_KMOD=y
BR2_PACKAGE_UTIL_LINUX=y
BR2_PACKAGE_UTIL_LINUX_LIBBLKID=y
BR2_TARGET_ROOTFS_EXT2=y
BR2_TARGET_ROOTFS_EXT2_3=y
BR2_TARGET_ROOTFS_EXT2_SIZE="128M"
# BR2_TARGET_ROOTFS_TAR is not set
BR2_PACKAGE_HOST_GENEXT2FS=y
BR2_PACKAGE_HOST_GENIMAGE=y
```
